## conf/layer.conf
```bitbake
# This software is a part of LotOS framework.
# 
# Copyright (c) 2015 ilbers GmbH

# We have a conf and classes directory, add to BBPATH
BBPATH .= ":${LAYERDIR}"

# We have recipes-* directories, add to BBFILES
BBFILES += "${LAYERDIR}/recipes-*/*/*.bb \
            ${LAYERDIR}/recipes-*/*/*.bbappend"

BBFILE_COLLECTIONS += "lotos"
BBFILE_PATTERN_lotos = "^${LAYERDIR}/"
BBFILE_PRIORITY_lotos = "5"
LAYERVERSION_lotos = "1"

LICENSE_PATH += "${LAYERDIR}/custom-licenses"
```

## conf/machine/arndale-lotos.conf
```bitbake
#@TYPE: Machine
#@NAME: Arndale machine
#@DESCRIPTION: Machine configuration for the Anrdale board

require conf/machine/include/tune-cortexa15.inc

KERNEL_IMAGETYPE = "zImage"

UBOOT_ENTRYPOINT = "0x80008000"
UBOOT_LOADADDRESS = "0x80008000"

KERNEL_DEVICETREE = "exynos5250-arndale.dtb"

EXTRA_IMAGEDEPENDS += "                    \
                       u-boot-exynos-lotos \
                       freertos            \
                       mango-exynos5250    \
                      "


PREFERRED_PROVIDER_virtual/xserver = "xserver-xorg"
XSERVER = "xserver-xorg \
           xf86-input-evdev \
           xf86-video-modesetting \
           xf86-video-fbdev"

# Only has DVI connector for external screen
GUI_MACHINE_CLASS = "bigscreen"

PREFERRED_PROVIDER_virtual/kernel = "linux-exynos-lotos"
PREFERRED_PROVIDER_kernel-devicetree = "linux-exynos-lotos"

IMAGE_FSTYPES_append = " tar.xz "

# Guesswork
SERIAL_CONSOLE = "115200 ttySAC2"

UBOOT_MACHINE = "arndale_config"

# and sdio
MACHINE_FEATURES = "kernel26 screen apm usbgadget usbhost vfat alsa"

PREFERRED_PROVIDER_virtual/libgl = "mesa-gl"
PREFERRED_PROVIDER_virtual/mesa = "mesa-gl"

SOC_TYPE = "exynos5250"
BOARD_TYPE = "arndale"

# Framework packets revisions:
SRCREV_pn-freertos = "576cec62658cfae07b8b0d9f5de3a018a00615d6"
SRCREV_pn-mango-apps = "4fd527585b0c05fe154c00defcd24f8368447797"
SRCREV_pn-mango-utils = "646e319b79f3a637653c2c3563dc6bcae35c1d3f"
SRCREV_pn-linux-mango-ext = "fc04ae69bd5e136d22910040f683905511386e61"
```

## conf/machine/bananapi-lotos.conf
```bitbake
# This software is a part of LotOS framework.
# 
# Based on meta-sunxi/conf/machine/bananapi.conf
#
# Copyright (c) 2015 ilbers GmbH

#@TYPE: Machine
#@NAME: Bananapi
#@DESCRIPTION: Machine configuration for the bananapi, based on allwinner A20 CPU http://bananapi.org/

SOC_FAMILY = "sun7i"
include conf/machine/include/soc-family.inc

require conf/machine/include/sunxi-mali.inc
require conf/machine/include/tune-cortexa7.inc

# Sub-architecture support
MACHINE_SOCARCH_SUFFIX ?= ""

PREFERRED_PROVIDER_virtual/xserver = "xserver-xorg"
XSERVER = "xserver-xorg \
           xf86-video-fbturbo \
           xf86-input-evdev \
           xf86-input-mouse \
           xf86-input-keyboard"

PREFERRED_PROVIDER_virtual/kernel ?= "linux-sunxi-lotos"
PREFERRED_PROVIDER_u-boot ?= "u-boot-sunxi-lotos"
PREFERRED_PROVIDER_virtual/bootloader ?= "u-boot-sunxi-lotos"

KERNEL_IMAGETYPE ?= "zImage"

IMAGE_CLASSES += "sdcard_image-lotos"
IMAGE_FSTYPES += "ext3 tar.gz sunxi-sdimg"

MACHINE_EXTRA_RRECOMMENDS = "kernel-modules"

UBOOT_LOCALVERSION = "-g${@d.getVar('SRCPV', True).partition('+')[2][0:7]}"

UBOOT_ENTRYPOINT ?= "0x40008000"
UBOOT_LOADADDRESS ?= "0x400080OB00"

SERIAL_CONSOLE ?= "115200 ttyS0"
MACHINE_FEATURES ?= "alsa apm keyboard rtc serial screen usbgadget usbhost vfat"

KERNEL_DEVICETREE = ""
UBOOT_MACHINE = "Bananapi_config"
SUNXI_FEX_FILE = "sys_config/a20/Bananapi.fex"

SOC_TYPE = "a20"
BOARD_TYPE = "bananapi"
```

## conf/machine/bpi-lotos.conf
```bitbake
# This software is a part of LotOS framework.
# 
# Based on meta-sunxi/conf/machine/bananapi.conf
#
# Copyright (c) 2015-2016 ilbers GmbH

#@TYPE: Machine
#@NAME: Bananapi
#@DESCRIPTION: Machine configuration for the bananapi, based on allwinner A20 CPU http://bananapi.org/

SOC_FAMILY = "sun7i"
include conf/machine/include/soc-family.inc

require conf/machine/include/sunxi-mali.inc
require conf/machine/include/tune-cortexa7.inc

DEFAULTTUNE = "cortexa7hf-neon-vfpv4"

# Sub-architecture support
MACHINE_SOCARCH_SUFFIX ?= ""

PREFERRED_PROVIDER_virtual/xserver = "xserver-xorg"
XSERVER = "xserver-xorg \
           xf86-video-fbturbo \
           xf86-input-evdev \
           xf86-input-mouse \
           xf86-input-keyboard"

PREFERRED_PROVIDER_virtual/kernel ?= "linux-sunxi-lotos"
PREFERRED_PROVIDER_u-boot ?= "u-boot-bpi-lotos"
PREFERRED_PROVIDER_virtual/bootloader ?= "u-boot-bpi-lotos"

# Mango Hypervisor recipe
PREFERRED_PROVIDER_mango ?= "mango-a20"

KERNEL_IMAGETYPE ?= "zImage"

IMAGE_CLASSES += "sdcard_image-lotos"
IMAGE_FSTYPES := "ext4 bpi-sdimg"

MACHINE_EXTRA_RRECOMMENDS = "kernel-modules"

UBOOT_LOCALVERSION = "-g${@d.getVar('SRCPV', True).partition('+')[2][0:7]}"

UBOOT_ENTRYPOINT ?= "0x40008000"
UBOOT_LOADADDRESS ?= "0x400080OB00"

SERIAL_CONSOLE ?= "115200 ttyS0"
MACHINE_FEATURES ?= "alsa apm keyboard rtc serial screen usbgadget usbhost vfat"

KERNEL_DEVICETREE = ""
UBOOT_MACHINE = "Bananapi_config"
SUNXI_FEX_FILE = "sys_config/a20/Bananapi.fex"

SOC_TYPE = "a20"
BOARD_TYPE = "bananapi"

# Framework packets revisions:
SRCREV_pn-freertos = "9937f63c3becdd83f2953419ee67a9878a5002c4"
SRCREV_pn-mango-apps = "6f95f8a7ef0da439e808da342ade21ba1196fa40"
SRCREV_pn-mango-utils = "b02ba7bc37fad31536e0398e6728e15ef1560636"
SRCREV_pn-linux-mango-ext = "f36ec6d01594715b8e804f900928247aa1dce4ac"
```

## recipes-bsp/u-boot/u-boot-bpi-lotos/lotos.its
```
/*
 * Script to build LotOS FIT image.
 * This software is a part of LotOS Framework.
 *
 * Alexander Smirnov <asmirnov@ilbers.de>
 * Copyright (c) 2014-2016 ilbers GmbH
 */

/dts-v1/;

/ {
	description = "LotOS Framework FDT Blobs";
	#address-cells = <1>;

	images {
		kernel@1 {
			description = "Mango Hypervisor v1.4";
			data = /incbin/("./mango.Image");
			type = "kernel";
			arch = "arm";
			os = "linux";
			compression = "none";
			load = <0x7d200000>;
			entry = <0x7d200000>;
			hash@1 {
				algo = "md5";
			};
			hash@2 {
				algo = "sha1";
			};
			signature@1 {
				algo = "sha1,rsa2048";
				key-name-hint = "dev";
			};
		};

		standalone@1 {
			description = "Linux Kernel v3.4.103";
			data = /incbin/("./zImage");
			type = "standalone";
			arch = "arm";
			compression = "gzip";
			load = <0x7e000000>;
			entry = <0x7e000000>;
			hash@1 {
				algo = "md5";
			};
			hash@2 {
				algo = "sha1";
			};
			signature@1 {
				algo = "sha1,rsa2048";
				key-name-hint = "dev";
			};
		};

		standalone@2 {
			description = "FreeRTOS v8.2.1";
			data = /incbin/("./freertos.Image");
			type = "standalone";
			arch = "arm";
			compression = "none";
			load = <0x7f000000>;
			entry = <0x7f000000>;
			hash@1 {
				algo = "md5";
			};
			hash@2 {
				algo = "sha1";
			};
			signature@1 {
				algo = "sha1,rsa2048";
				key-name-hint = "dev";
			};
		};

		script@1 {
			description = "Mango Configuration File";
			data = /incbin/("./config.bin");
			type = "script";
			arch = "arm";
			compression = "none";
			load = <0x73000000>;
			hash@1 {
				algo = "md5";
			};
			hash@2 {
				algo = "sha1";
			};
			signature@1 {
				algo = "sha1,rsa2048";
				key-name-hint = "dev";
			};
		};

		script@2 {
			description = "BananaPi Configuration File";
			data = /incbin/("./fex.bin");
			type = "script";
			arch = "arm";
			compression = "none";
			load = <0x7e600000>;
			hash@1 {
				algo = "md5";
			};
			hash@2 {
				algo = "sha1";
			};
			signature@1 {
				algo = "sha1,rsa2048";
				key-name-hint = "dev";
			};
		};
	};

	configurations {
		default = "conf@1";

		conf@1 {
			description = "LotOS Framework";
			kernel = "kernel@1";
			loadables = "standalone@1", "standalone@2", "script@1", "script@2";
			signature@1 {
				algo = "sha1,rsa2048";
				key-name-hint = "dev";
			};
		};
	};
};
```
